## CMakeLists.txt
```
# Copyright (c) 2024
# SPDX-License-Identifier: Apache-2.0
cmake_minimum_required(VERSION 3.20.0)
set(ZEPHYR_EXTRA_MODULES "${CMAKE_SOURCE_DIR}/modules")
find_package(Zephyr REQUIRED HINTS $ENV{ZEPHYR_BASE})
project(test VERSION 1.0)

target_sources(app PRIVATE src/main.c)
zephyr_syscall_include_directories("${CMAKE_SOURCE_DIR}/modules/sevenseg/include")
zephyr_include_directories("${CMAKE_SOURCE_DIR}/modules/sevenseg/include")
```

## prj.conf
```kconfig
CONFIG_SEVENSEGMENT=y
CONFIG_GPIO=y
```

## boards/apollo3_evb.overlay
```dts
/ {
    seven_segment: seven_segment {
        compatible = "seven-segment";
        segment-gpios =
                <&gpio0_31 10 GPIO_ACTIVE_HIGH>,
                <&gpio0_31 28 GPIO_ACTIVE_HIGH>,
                <&gpio0_31 16 GPIO_ACTIVE_HIGH>,
                <&gpio0_31 18 GPIO_ACTIVE_HIGH>,
                <&gpio0_31 19 GPIO_ACTIVE_HIGH>,
                <&gpio0_31 30 GPIO_ACTIVE_HIGH>,
                <&gpio0_31 15 GPIO_ACTIVE_HIGH>;
        drive-mode = <0>; /* 0: Common Cathode, 1: Common Anode */
        common-gpios = <&gpio0_31 5 GPIO_ACTIVE_HIGH>;
        refresh-rate = <0>;
        status="okay";
    };
};
```

## src/main.c
```c
#include <zephyr/kernel.h>
#include <zephyr/device.h>
#include <sevensegment/seven_segment.h>

int main(void)
{
    const struct device *seven_seg_dev = DEVICE_DT_GET(DT_NODELABEL(seven_segment));

    if (!device_is_ready(seven_seg_dev))
    {
        printk("7-segment display device not ready\n");
        return -ENODEV;
    }

    while (1)
    {
        // Display digits 0-9 in a loop
        for (uint8_t digit = 0; digit < 10; digit++)
        {
            int ret = display(seven_seg_dev, &digit);
            if (ret < 0)
            {
                printk("Failed to display digit: %d\n", ret);
            }
            else
            {
                printk("Digit %d displayed successfully\n", digit);
            }
            k_sleep(K_MSEC(2000)); // Pause for 500ms
        }
    }

    return 0;
}
```
