## modules/sevenseg/drivers/Kconfig
```kconfig
# Copyright (c) 2024 Ali Sarlak
# SPDX-License-Identifier: Apache-2.0

menu "Seven Segment"
rsource "sevensegment/Kconfig"
endmenu
```

## modules/sevenseg/drivers/sevensegment/Kconfig
```kconfig
# Copyright (c) 2024 Ali Sarlak
# SPDX-License-Identifier: Apache-2.0

config SEVENSEGMENT
	bool "Seven Segment Display"
	default y
	select GPIO
	help
	  Seven Segment Digit Display.
```

## modules/sevenseg/dts/bindings/sevensegment/seven-segment.yml
```yaml
# Copyright (c) 2024
# SPDX-License-Identifier: Apache-2.0

description: 7seg display

compatible: "seven-segment"

include: base.yaml

properties:
  segment-gpios:
    type: phandle-array
    required: true
    description: |
      GPIO phandles with flags for the seven-segment display pins in order: g, f, e, d, c, b, a.
  drive-mode:
    type: int
    required: true
    default: 1
    description: |
      Drive mode of the display: 0 for Common Cathode, 1 for Common Anode.
    enum: [0, 1] # Restricts values to 0 or 1

  common-gpios:
    type: phandle-array
    required: true
    description: |
      GPIO phandle with flags for the common pin of the display.

  refresh-rate:
    type: int
    required: true
    default: 0
    description: |
      Refresh rate of the display in Hz.
```
